## yocto/meta-spotflow/conf/layer.conf
```bitbake
# Layer configuration for meta-spotflow
# Provides: spotflowd observability daemon for the Spotflow platform

# We have a conf and classes directory, add to BBPATH
BBPATH .= ":${LAYERDIR}"

# We have recipes-* directories, add to BBFILES
BBFILES += "${LAYERDIR}/recipes-*/*/*.bb \
            ${LAYERDIR}/recipes-*/*/*.bbappend"

BBFILE_COLLECTIONS += "meta-spotflow"
BBFILE_PATTERN_meta-spotflow = "^${LAYERDIR}/"
BBFILE_PRIORITY_meta-spotflow = "6"

LAYERDEPENDS_meta-spotflow = "core"
LAYERSERIES_COMPAT_meta-spotflow = "scarthgap styhead"
```
